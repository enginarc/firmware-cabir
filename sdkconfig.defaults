## sdkconfig.defaults
```kconfig
# Bluetooth — NimBLE only
CONFIG_BT_ENABLED=y
CONFIG_BT_NIMBLE_ENABLED=y
CONFIG_BT_BLUEDROID_ENABLED=n
CONFIG_BT_NIMBLE_MEM_ALLOC_MODE_INTERNAL=y
CONFIG_BT_NIMBLE_MAX_CONNECTIONS=1

# NimBLE role: peripheral only
CONFIG_BT_NIMBLE_ROLE_OBSERVER=n
CONFIG_BT_NIMBLE_ROLE_CENTRAL=n

# ADC calibration
CONFIG_ADC_CAL_EFUSE_TP_ENABLE=y
CONFIG_ADC_CAL_EFUSE_VREF_ENABLE=y
CONFIG_ADC_CAL_LUT_ENABLE=y

# SPI
CONFIG_SPI_MASTER_IN_IRAM=y

# FreeRTOS tick rate (1ms resolution for TPC timing)
CONFIG_FREERTOS_HZ=1000

# Logging
CONFIG_LOG_DEFAULT_LEVEL_INFO=y

# NVS
CONFIG_NVS_ALLOW_PAGE_FULL=y

# Stack sizes
CONFIG_MAIN_TASK_STACK_SIZE=8192
```
